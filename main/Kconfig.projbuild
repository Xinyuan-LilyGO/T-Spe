## main/Kconfig.projbuild
```kconfig
menu "Example Configuration"

    choice
        prompt "Select the example to build"
        default EXAMPLE_BUILD_LAN8671
            config EXAMPLE_BUILD_LAN8671
                bool "lan8671"
            config EXAMPLE_BUILD_WIFI
                bool "wifi"
            config EXAMPLE_BUILD_IPERF_ETHERNET
                bool "iperf_ethernet"
            config EXAMPLE_BUILD_RS485
                bool "rs485"
            config EXAMPLE_BUILD_WIFI_HTTP_DOWNLOAD_FILE
                bool "wifi_http_download_file"
    endchoice
endmenu
```

## sdkconfig.defaults
```kconfig
CONFIG_DEVICE_T_SPE=y

CONFIG_IDF_TARGET="esp32"
CONFIG_ESP_DEFAULT_CPU_FREQ_MHZ_240=y
CONFIG_ESPTOOLPY_FLASHSIZE_16MB=y
CONFIG_ESPTOOLPY_FLASHFREQ_80M=y
CONFIG_ESPTOOLPY_FLASHMODE_QIO=y
CONFIG_PARTITION_TABLE_CUSTOM=y
CONFIG_PARTITION_TABLE_CUSTOM_FILENAME="partitions_esp32.csv"

CONFIG_FREERTOS_HZ=1000

CONFIG_SPIRAM=y

CONFIG_IDF_EXPERIMENTAL_FEATURES=y

CONFIG_FREERTOS_TIMER_TASK_STACK_DEPTH=8192

CONFIG_LWIP_TCP_SND_BUF_DEFAULT=65534
CONFIG_LWIP_TCP_WND_DEFAULT=65534
CONFIG_LWIP_TCP_RECVMBOX_SIZE=64
CONFIG_LWIP_UDP_RECVMBOX_SIZE=64
CONFIG_LWIP_TCPIP_RECVMBOX_SIZE=64

CONFIG_LWIP_TCP_SACK_OUT=y

CONFIG_LWIP_IP4_REASSEMBLY=y
CONFIG_LWIP_IP6_REASSEMBLY=y
CONFIG_LWIP_IP_REASS_MAX_PBUFS=64

CONFIG_LWIP_IRAM_OPTIMIZATION=y

CONFIG_ETHERNET_PHY_LAN867X=y
CONFIG_ETHERNET_PHY_INTERFACE_RMII=y
CONFIG_ETHERNET_MDC_GPIO=14
CONFIG_ETHERNET_MDIO_GPIO=32
CONFIG_ETHERNET_PHY_RST_GPIO=23
CONFIG_ETHERNET_PHY_ADDR=15

CONFIG_ETH_IRAM_OPTIMIZATION=y
```
